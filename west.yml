## west.yml
```yaml
manifest:
  remotes:
    - name: zmkfirmware
      url-base: https://github.com/zmkfirmware
    - name: myfork
      url-base: https://github.com/BWV548

  projects:
    - name: zmk
      remote: myfork
      revision: main
      path: zmk
      import: app/west.yml

    - name: zephyr
      remote: zmkfirmware
      revision: main
      import: west.yml

  self:
    path: config
```
